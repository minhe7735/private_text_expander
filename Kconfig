## Kconfig
```kconfig
mainmenu "ZMK Text Expander"

menu "ZMK Text Expander"

config ZMK_TEXT_EXPANDER
    bool "Enable Text Expander Behavior"
    default n
    help
      Enable the text expander module to define and use text expansions.

if ZMK_TEXT_EXPANDER

config ZMK_TEXT_EXPANDER_TYPING_DELAY
    int "Typing delay between characters (ms)"
    default 10
    help
      Sets the delay in milliseconds between each typed character during expansion.

config ZMK_TEXT_EXPANDER_EVENT_QUEUE_SIZE
    int "Size of the key event queue"
    default 16
    range 4 64
    help
      Sets the number of key press/release events that can be buffered.
      Increase this if you see 'Failed to queue key event' warnings.

config ZMK_TEXT_EXPANDER_AGGRESSIVE_RESET_MODE
    bool "Aggressive Reset Mode"
    default n
    help
      If enabled, the current short code will be reset immediately if it does
      not match a valid prefix of any stored expansion.

config ZMK_TEXT_EXPANDER_RESTART_AFTER_RESET_WITH_TRIGGER_CHAR
    bool "Restart short code with trigger character after a reset"
    depends on ZMK_TEXT_EXPANDER_AGGRESSIVE_RESET_MODE
    default n
    help
      If the short code is reset (e.g., in aggressive mode), the character
      that caused the reset will be used to start a new short code.

config ZMK_TEXT_EXPANDER_ULTRA_LOW_MEMORY
    bool "Enable Ultra Low Memory Mode"
    default n
    help
      Reduces memory footprint by removing the comprehensive character-to-keycode
      lookup table. This limits expansions to basic alphanumeric characters and a
      wide range of common symbols.

config ZMK_TEXT_EXPANDER_DEFAULT_OS_LINUX
    bool "Default to Linux for Unicode input"
    help
      Sets the default OS for Unicode text expansion to Linux. This has the
      highest priority.

config ZMK_TEXT_EXPANDER_DEFAULT_OS_MACOS
    bool "Default to macOS for Unicode input"
    depends on !ZMK_TEXT_EXPANDER_DEFAULT_OS_LINUX
    help
      Sets the default OS for Unicode text expansion to macOS. This option
      is ignored if the Linux default is selected.

config ZMK_TEXT_EXPANDER_DEFAULT_OS_WINDOWS
    bool "Default to Windows for Unicode input"
    depends on !ZMK_TEXT_EXPANDER_DEFAULT_OS_LINUX && !ZMK_TEXT_EXPANDER_DEFAULT_OS_MACOS
    default y
    help
      Sets the default OS for Unicode text expansion to Windows. This is the
      default and is ignored if either the Linux or macOS default is selected.

endif

endmenu
```

## dts/bindings/behaviors/zmk,behavior-text-expander.yaml
```yaml
description: Text expander behavior for ZMK
compatible: "zmk,behavior-text-expander"
include: zero_param.yaml

properties:
  undo-keycodes:
    type: array
    required: false
    description: "A list of keycodes that will trigger an undo of the last expansion."

  reset-keycodes:
    type: array
    required: false
    description: "A list of keycodes that will reset the current short code buffer."

  auto-expand-keycodes:
    type: array
    required: false
    description: "A list of keycodes that will automatically trigger an expansion."

  disable-preserve-trigger:
    type: boolean
    required: false
    description: |
      If present, this flag sets the global default to NOT replay a
      trigger key (like space or enter) after an expansion. The default
      behavior without this flag is to preserve the trigger. This can be
      overridden on a per-expansion basis.

child-binding:
  description: |
    Text expansion definition. Each child node defines a short code and
    its corresponding expanded text.

  properties:
    short-code:
      type: string
      required: true
    expanded-text:
      type: string
      required: true
    preserve-trigger:
      type: boolean
      required: false
      description: "Explicitly preserves the trigger key for this expansion, overriding the global default."
    disable-preserve-trigger:
      type: boolean
      required: false
      description: "Explicitly disables preserving the trigger key for this expansion, overriding the global default."
```
